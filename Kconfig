## boards/arm/nemu-link-dongle/Kconfig.defconfig
```kconfig
if BOARD_NEMU_LINK_DONGLE

config USB_NRFX
    default y if USB_DEVICE_STACK

choice ZMK_BOOTMODE_MAGIC_VALUE_BOOTLOADER_TYPE
    default ZMK_BOOTMODE_MAGIC_VALUE_BOOTLOADER_TYPE_ADAFRUIT_NRF52
endchoice

endif
```

## boards/arm/nemu-link-dongle/Kconfig.nemu-link-dongle
```kconfig
config BOARD_NEMU_LINK_DONGLE
    select SOC_NRF52833_QIAA
    select ZMK_SPLIT if !ZMK_BLE
    select ZMK_SPLIT_ROLE_CENTRAL if !ZMK_BLE
    select ZMK_NEMU_LINK if !ZMK_BLE
    select ZMK_USB
    select SETTINGS
    select MBEDTLS
    select MBEDTLS_PSA_CRYPTO_C
    imply ZMK_MOUSE
    imply ZMK_INPUT_SPLIT
```

## boards/arm/nemu-link-dongle/nemu-link-dongle_defconfig
```kconfig
CONFIG_ARM_MPU=y
CONFIG_PINCTRL=y
CONFIG_GPIO=y
CONFIG_USE_DT_CODE_PARTITION=y
CONFIG_BUILD_OUTPUT_UF2=y
CONFIG_MPU_ALLOW_FLASH_WRITE=y
CONFIG_NVS=y
CONFIG_SETTINGS_NVS=y
CONFIG_FLASH=y
CONFIG_FLASH_PAGE_LAYOUT=y
CONFIG_FLASH_MAP=y
CONFIG_CLOCK_CONTROL_NRF=y
CONFIG_CLOCK_CONTROL_NRF_K32SRC_RC=n
CONFIG_CLOCK_CONTROL_NRF_K32SRC_XTAL=n
CONFIG_CLOCK_CONTROL_NRF_K32SRC_SYNTH=y
CONFIG_CLOCK_CONTROL_NRF_K32SRC_100PPM=y
CONFIG_ZMK_BLE=n
CONFIG_ZMK_SPLIT_BLE=n
CONFIG_ZMK_SPLIT_WIRED=n
CONFIG_ZMK_EXT_POWER=n
CONFIG_RETAINED_MEM=y
CONFIG_RETENTION=y
CONFIG_RETENTION_BOOT_MODE=y
CONFIG_ZMK_BOOTMODE_MAGIC_VALUE_BOOTLOADER_TYPE_ADAFRUIT_NRF52=y
CONFIG_ESB_MAX_PAYLOAD_LENGTH=64
CONFIG_SYSTEM_WORKQUEUE_STACK_SIZE=4096
CONFIG_MBEDTLS_HEAP_SIZE=4096
```

## config/west.yml
```yaml
manifest:
  projects:
    - name: nrf
      url: https://github.com/sekigon-gonnoc/sdk-nrf
      revision: zmk-v0.4+nemu-link
    - name: nrfxlib
      url: https://github.com/nrfconnect/sdk-nrfxlib
      revision: dfadf17305d8f000eda9aa74a5b9ff1c5647a23e
```

## dts/bindings/behaviors/zmk,behavior-nemu-link-mode.yaml
```yaml
description: Request ESB (1), BLE (0), or toggle (2) runtime mode
compatible: "zmk,behavior-nemu-link-mode"
include: one_param.yaml
```

## dts/bindings/sekigon,nemu-link-input-reg.yaml
```yaml
# Copyright (c) 2026 The nemu-link Contributors
# SPDX-License-Identifier: MIT

description: Map an input-listener instance to a nemu-link wire input register

compatible: "sekigon,nemu-link-input-reg"

properties:
  listener-index:
    type: int
    required: true
  wire-reg:
    type: int
    required: true
```

## dts/bindings/sekigon,nemu-link-radio.yaml
```yaml
# Copyright (c) 2025 The ZMK Contributors
# SPDX-License-Identifier: MIT

description: |
  Complete specification of ESB split connection

compatible: "sekigon,nemu-link-radio"

properties:
  addr-prefix:
    type: array
    default: [0x36, 0xa9]
    description: "base address 0"
```

## dts/bindings/sekigon,nemu-link.yaml
```yaml
compatible: "sekigon,nemu-link"
description: ESB mode controls
properties:
  source-0-switch-positions:
    type: array
    description: Global key positions held together to switch modes; absent disables this source
  source-1-switch-positions:
    type: array
  mode-switch-gpios:
    type: phandle-array
    description: Optional active-level momentary switch; a press toggles BLE/ESB
```
